## Kconfig
```kconfig
source "Kconfig.zephyr"

config TOP_SHELL
    bool "Enable top-like screen in shell"
    depends on SHELL
    default y

config RDD2_DFU_SHELL
    bool "dfu shell command: reboot into the STM32 ROM bootloader"
    depends on SHELL && SOC_SERIES_STM32F4X
    select REBOOT
    select SOC_RESET_HOOK
    help
      Adds a `dfu` command that warm-reboots into the ROM DFU bootloader
      via a noinit magic checked in the reset hook, so reflashing over
      USB never needs the BOOT0 button.

config RDD2_RC_SYNAPSE
    bool "RC from the ManualControl topic over the serial transport"
    depends on RDD2_ZROS_SERIAL
    depends on INPUT
    help
      Accept ManualControlData frames on the synapse serial link and
      replay them as input events on the cognipilot,synapse-rc device
      named by the rc alias. This is the RC path for a ground station
      link (e.g. WiFi through a UART bridge) with no hardware receiver;
      rc_input.c and the arming/staleness logic are unchanged. The RC
      failsafe is the existing staleness timeout, so the ground station
      must send at a fixed cadence.

config RDD2_IMU_TELEMETRY
    bool "Stream decimated raw IMU samples over the serial link"
    depends on RDD2_ZROS_SERIAL
    help
      Publish the control loop's raw gyro/accel samples (body FLU, SI
      units) onto the inertial_sample topic and carry it over the
      serial transport at its own rate, for estimator debugging and
      vibration analysis from the ground station. Costs link bandwidth
      and nothing else; disable for flight once tuning is done.

config RDD2_IMU_TELEMETRY_DIV
    int "Control cycles per transmitted IMU sample"
    depends on RDD2_IMU_TELEMETRY
    range 1 64
    default 4
    help
      Every Nth control cycle publishes one raw sample: 4 at an 800 Hz
      loop is 200 Hz on the wire (~13 KB/s framed), good for spectra to
      100 Hz. The serial transport's poll period (5 ms default) is the
      other rate ceiling.

config RDD2_IMU_TRIGGER
    bool "Data-ready trigger IMU acquisition"
    depends on SENSOR
    help
      Pace the control loop from the IMU's data-ready trigger through the
      classic fetch/get sensor API, for IMU drivers without sensor
      streaming (RTIO) support such as the BMI270. The trigger handler
      reads the sample in driver context and queues it for the control
      thread.

config RDD2_IMU_TRIGGER_ODR_HZ
    int "IMU output data rate for the trigger backend in Hz"
    depends on RDD2_IMU_TRIGGER
    default 800
    help
      Requested accelerometer and gyroscope sampling frequency. The
      data-ready rate is the control loop rate. Drivers that do not
      accept the request keep their default rate; the loop adapts via
      measured dt either way.
    
menu "RDD2"

rsource "subsys/Kconfig"
rsource "drivers/Kconfig"

endmenu
```

## dts/bindings/cognipilot,pwm-motors.yaml
```yaml
# SPDX-License-Identifier: Apache-2.0

description: |
  Quad motor bank driven through per-motor PWM specifiers.

  One pwms entry per motor, in mixer order (m1..m4). Each entry carries its
  own controller, channel, period, and flags, so the four motors may span
  multiple timers and mix polarity or complementary outputs, e.g.:

    pwms = <&pwm3 1 PWM_HZ(400) PWM_POLARITY_NORMAL>,
           <&pwm3 4 PWM_HZ(400) PWM_POLARITY_NORMAL>,
           <&pwm1 3 PWM_HZ(400) STM32_PWM_COMPLEMENTARY>,
           <&pwm1 1 PWM_HZ(400) STM32_PWM_COMPLEMENTARY>;

  companion-gpios are driven to their logical INACTIVE state at init and left
  there: for an H-bridge input that must sit low, list it GPIO_ACTIVE_HIGH;
  for one that must sit high (slow-decay partner), list it GPIO_ACTIVE_LOW.

  enable-gpios (e.g. DRV8833 NSLEEP) is asserted only while motors are
  commanded with arming authority and deasserted on every disarmed write, so
  the power stage sleeps whenever the vehicle is disarmed.

  fault-gpios is sampled on each write; list it with the flags that make a
  reported fault read as logical 1 (open-drain FAULT low-active is
  GPIO_ACTIVE_LOW with a pull-up on the board).

compatible: "cognipilot,pwm-motors"

properties:
  pwms:
    type: phandle-array
    required: true
    description: One PWM specifier per motor, mixer order m1..m4.

  enable-gpios:
    type: phandle-array
    description: Power-stage enable, asserted only while armed or testing.

  fault-gpios:
    type: phandle-array
    description: Power-stage fault input, logical 1 when faulted.

  companion-gpios:
    type: phandle-array
    description: Static H-bridge companion inputs, driven inactive at init.
```

## dts/bindings/cognipilot,synapse-rc.yaml
```yaml
# SPDX-License-Identifier: Apache-2.0

description: |
  Virtual RC input device fed from inbound ManualControl frames on the
  synapse serial transport (CONFIG_RDD2_RC_SYNAPSE). Point the rc alias at
  this node when the RC link is the ground station rather than a hardware
  receiver.

compatible: "cognipilot,synapse-rc"

include: base.yaml
```

## subsys/Kconfig
```kconfig
menu "Subsystems"

rsource "battery/Kconfig"
rsource "zros_serial/Kconfig"
rsource "gnss_source/Kconfig"
rsource "lockstep/Kconfig"

endmenu
```

## subsys/battery/Kconfig
```kconfig
# SPDX-License-Identifier: Apache-2.0

config RDD2_BATTERY
    bool "Battery voltage monitor"
    depends on ADC
    help
      Sample the battery voltage divider on the vbat devicetree alias
      (a voltage-divider node) at low rate and publish it through
      vehicle_health as voltage_battery_cv plus a linear remaining-charge
      estimate. Exposes rdd2_battery_low() for the arming gate.

if RDD2_BATTERY

config RDD2_BATTERY_FULL_MV
    int "Battery voltage considered 100% in mV"
    default 4200

config RDD2_BATTERY_EMPTY_MV
    int "Battery voltage considered 0% in mV"
    default 3300

config RDD2_BATTERY_LOW_MV
    int "Low-battery threshold in mV"
    default 3450
    help
      rdd2_battery_low() reports true after the voltage has stayed below
      this threshold for several consecutive samples, so stick punches
      and sag spikes do not flap the flag.

config RDD2_BATTERY_ARM_GATE
    bool "Refuse to arm while the battery is low"
    help
      Blocks new arming while rdd2_battery_low() reports true. Never
      force-disarms in flight; recovery from in-flight sag is the
      pilot's call. Leave disabled on bench boards without the divider
      populated.

endif
```
